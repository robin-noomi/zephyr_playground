## CMakeLists.txt
```
# SPDX-License-Identifier: Apache-2.0

cmake_minimum_required(VERSION 3.13.1)
find_package(Zephyr REQUIRED HINTS $ENV{ZEPHYR_BASE})
project(blinky)

# include(utils/cmake/utils.cmake)

# Needed for colorful output
zephyr_compile_options(-fdiagnostics-color=always)

# NORDIC SDK APP START

# set(INCLUDES
    # edge-impulse-custom/ingestion-sdk-c
    # edge-impulse-custom/ingestion-sdk-platform/NordicSemi-nrf52
    # edge-impulse-custom/ingestion-sdk-platform/NordicSemi-nrf52/sensors
    # edge-impulse-custom/mbedtls_hmac_sha256_sw
    # edge-impulse-custom/QCBOR/inc
    # edge-impulse-custom/QCBOR/src
    # edge-impulse-custom/repl
    # )
# include_directories(${INCLUDES})

# RECURSIVE_FIND_FILE(SOURCE_FILES "edge-impulse-custom/ingestion-sdk-platform/NordicSemi-nrf52" "*.cpp")
# RECURSIVE_FIND_FILE(REPL_FILES "edge-impulse-custom/repl" "*.cpp")
# RECURSIVE_FIND_FILE(INGESTION_FILES "edge-impulse-custom/ingestion-sdk-c/" "*.cpp")
# RECURSIVE_FIND_FILE(QCBOR_FILES "edge-impulse-custom/QCBOR/src" "*.c")
# RECURSIVE_FIND_FILE(MBEDTLS_FILES "edge-impulse-custom/mbedtls_hmac_sha256_sw/mbedtls/src" "*.c")

# list(APPEND SOURCE_FILES ${REPL_FILES})
# list(APPEND SOURCE_FILES ${INGESTION_FILES})
# list(APPEND SOURCE_FILES ${QCBOR_FILES})
# list(APPEND SOURCE_FILES ${MBEDTLS_FILES})

# # add all sources to the project
# target_sources(app PRIVATE ${SOURCE_FILES})

target_include_directories(app PRIVATE src/include)
target_sources(app PRIVATE src/ei_microphone.cpp)
target_sources(app PRIVATE src/main.c)

# NORDIC SDK APP END
```

## sample.yaml
```
sample:
  description: firmware-nordic-nrf52, the accelerometer and microphone Edge Impulse example for Zephyr
    application
  name: firmware-nordic-nrf52
common:
    tags: introduction
    filter: dt_enabled_alias_with_parent_compat("led0", "gpio-leds")
    depends_on: gpio
    harness: console, led
    harness_config:
      type: one_line
      regex:
        - "Hello World! (.*)"
```

## prj.conf
```kconfig
CONFIG_GPIO=y

# Using console with UART
CONFIG_CONSOLE=y
CONFIG_UART_CONSOLE=y
CONFIG_RTT_CONSOLE=n

# Enable shell
CONFIG_SHELL=y

# Enable Edge Impulse dependencies
CONFIG_CPLUSPLUS=y
CONFIG_STD_CPP11=y
CONFIG_LIB_CPLUSPLUS=y
CONFIG_NEWLIB_LIBC=y
CONFIG_NEWLIB_LIBC_FLOAT_PRINTF=y
CONFIG_FPU=y

# Enable Edge Impulse
CONFIG_EDGE_IMPULSE=y
#CONFIG_EDGE_IMPULSE_URI="http://studio.edgeimpulse.com/v1/api/33126/deployment/download?type=zip&modelType=int8"
CONFIG_EDGE_IMPULSE_URI="C:/Users/robin/Documents/zephyr_playground/keyword_test2-v4-v9"
CONFIG_EI_WRAPPER=y
CONFIG_EI_WRAPPER_DATA_BUF_SIZE=20000
CONFIG_EI_WRAPPER_THREAD_PRIORITY=0

# i2c configuration for accelerometer
CONFIG_I2C=y
CONFIG_I2C_NRFX=y

# enable PDM driver
CONFIG_NRFX_PDM=y

# External Flash memory
CONFIG_FLASH=y
CONFIG_FLASH_PAGE_LAYOUT=y
CONFIG_MPU_ALLOW_FLASH_WRITE=y
CONFIG_NORDIC_QSPI_NOR=y
CONFIG_NORDIC_QSPI_NOR_FLASH_LAYOUT_PAGE_SIZE=4096
```

## src/main.c
```c
/*
 * Copyright (c) 2016 Intel Corporation
 *
 * SPDX-License-Identifier: Apache-2.0
 */

#include <zephyr.h>
#include <device.h>
#include <devicetree.h>
#include <drivers/gpio.h>
//#include <model-parameters/model_metadata.h>
//#include <edge_impulse/src/edge_impulse_project/model-parameters/model_metadata.h>
//#include "edge_impulse/src/edge_impulse_project/model-parameters/model_metadata.h"

//#include <ei_run_classifier.h>
//#include "model-parameters/model_metadata.h"

/* 1000 msec = 1 sec */
#define SLEEP_TIME_MS   1000

/* The devicetree node identifier for the "led0" alias. */
#define LED0_NODE DT_ALIAS(led0)
#define LED3_NODE DT_ALIAS(led3)

#if DT_NODE_HAS_STATUS(LED0_NODE, okay)
#define LED0_LABEL	DT_GPIO_LABEL(LED0_NODE, gpios)
#define LED0_PIN	DT_GPIO_PIN(LED0_NODE, gpios)
#define LED0_FLAGS	DT_GPIO_FLAGS(LED0_NODE, gpios)
#else
/* A build error here means your board isn't set up to blink an LED. */
#error "Unsupported board: led0 devicetree alias is not defined"
#define LED0_LABEL	""
#define LED0_PIN	0
#define LED0_FLAGS	0
#endif

#if DT_NODE_HAS_STATUS(LED3_NODE, okay)
#define LED3_LABEL	DT_GPIO_LABEL(LED3_NODE, gpios)
#define LED3_PIN	DT_GPIO_PIN(LED3_NODE, gpios)
#define LED3_FLAGS	DT_GPIO_FLAGS(LED3_NODE, gpios)
#else
/* A build error here means your board isn't set up to blink an LED. */
#error "Unsupported board: led3 devicetree alias is not defined"
#define LED3_LABEL	""
#define LED3_PIN	0
#define LED3_FLAGS	0
#endif



#include <ei_wrapper.h>
//#include <ei_microphone.h>
#include "include/ei_microphone.h"
#include <string.h>

//#include "input_data.h"

#define FRAME_ADD_INTERVAL_MS	100

static size_t frame_surplus;
volatile bool prediction_running = false;

const struct device *led0_dev;
const struct device *led3_dev;


static void result_ready_cb(int err)
{
	if (err) {
		printk("Result ready callback returned error (err: %d)\n", err);
		return;
	}

	const char *label;
	float value;
	float anomaly;

	err = ei_wrapper_get_classification_results(&label, &value, &anomaly);

	if (err) {
		printk("Cannot get classification results (err: %d)", err);
	} else {
		printk("\nClassification results\n");
		printk("======================\n");
		printk("Label: %s\n", label);
		printk("Value: %.2f\n", value);
		if (ei_wrapper_classifier_has_anomaly()) {
			printk("Anomaly: %.2f\n", anomaly);
		}

                if (0 == strcmp("help", label))
                {		
                    gpio_pin_set(led0_dev, LED0_PIN, 1);
                }
                else if (0 == strcmp("nectarine", label))
                {
                    gpio_pin_set(led3_dev, LED3_PIN, 1);
                }

	}

	if (frame_surplus > 0) {
		err = ei_wrapper_start_prediction(0, 1);
		if (err) {
			printk("Cannot restart prediction (err: %d)\n", err);
                        prediction_running = false;
		} else {
			printk("Prediction restarted...\n");
                        prediction_running = true;
		}

		frame_surplus--;
	}
        else
        {
            prediction_running = false;
        }
}


#define EI_CLASSIFIER_INTERVAL_MS                0.0625
#define EI_CLASSIFIER_RAW_SAMPLE_COUNT           16000
#define EI_CLASSIFIER_RAW_SAMPLES_PER_FRAME      1
#define EI_CLASSIFIER_DSP_INPUT_FRAME_SIZE       (EI_CLASSIFIER_RAW_SAMPLE_COUNT * EI_CLASSIFIER_RAW_SAMPLES_PER_FRAME)

float mic_buffer[EI_CLASSIFIER_RAW_SAMPLE_COUNT] = {0};
//float mic_buffer[5];

static void run_nn(void)
{
    // summary of inferencing settings (from model_metadata.h)
    printk("Inferencing settings:\n");
    printk("\tInterval: %f", (float)EI_CLASSIFIER_INTERVAL_MS);
    printk("ms.\n");
    printk("\tFrame size: %d\n", EI_CLASSIFIER_DSP_INPUT_FRAME_SIZE);
    printk("\tSample length: %d ms.\n", EI_CLASSIFIER_RAW_SAMPLE_COUNT / 16);
    //printk("\tNo. of classes: %d\n", sizeof(ei_classifier_inferencing_categories) /
    //                                        sizeof(ei_classifier_inferencing_categories[0]));

    if (ei_microphone_inference_started())
    {
        ei_microphone_inference_end();
    }

    if (ei_microphone_inference_start(EI_CLASSIFIER_RAW_SAMPLE_COUNT) == false) {
        printk("ERR: Failed to setup audio sampling\r\n");
        return;
    }

    printk("Starting inferencing\n");

    while (1) {
        if (prediction_running)
        {
            // Wait for prediction to finish
            return;
        }
        printk("Starting inferencing in 2 s...\n");

        int err;
        bool cancelled = false;
        err = ei_wrapper_clear_data(&cancelled);
        if (0 != err)
        {
            printk("ei wrapper clear data failed, err_code:%d \n", err);
        }
        if (cancelled)
        {
            printk("Prediction was cancelled");
        }

        // instead of wait_ms, we'll wait on the signal, this allows threads to cancel us...
        k_msleep(2000);

        //if(ei_user_invoke_stop()) {
        //    printk("Inferencing stopped by user\r\n");
        //    break;
        //}

        printk("Recording...\n");

        ei_microphone_inference_reset_buffers();
        bool m = ei_microphone_inference_record();
        if (!m) {
            printk("ERR: Failed to record audio...\n");
            break;
        }

        printk("Recording done\n");

        //signal_t signal;
        //signal.total_length = EI_CLASSIFIER_RAW_SAMPLE_COUNT;
        //signal.get_data = &ei_microphone_audio_signal_get_data;
        //ei_impulse_result_t result = {0};

        //EI_IMPULSE_ERROR r = run_classifier(&signal, &result, debug);
        //if (r != EI_IMPULSE_OK) {
        //    printk("ERR: Failed to run classifier (%d)\n", r);
        //    break;
        //}

        //// print the predictions
        //printk("Predictions (DSP: %d ms., Classification: %d ms., Anomaly: %d ms.): \n",
        //    result.timing.dsp, result.timing.classification, result.timing.anomaly);
        //for (size_t ix = 0; ix < EI_CLASSIFIER_LABEL_COUNT; ix++) {
        //    printk("    %s: \t", result.classification[ix].label);
        //    printk(result.classification[ix].value);
        //    printk("\r\n");
        //}

        ei_microphone_audio_signal_get_data(0, EI_CLASSIFIER_RAW_SAMPLE_COUNT, mic_buffer);


	if (ARRAY_SIZE(mic_buffer) < ei_wrapper_get_window_size()) {
		printk("Not enough input data\n");
		return;
	}

	if (ARRAY_SIZE(mic_buffer) % ei_wrapper_get_frame_size() != 0) {
		printk("Improper number of input samples\n");
		return;
	}

	size_t cnt = 0;

	err = ei_wrapper_add_data(&mic_buffer[cnt],
				  ei_wrapper_get_window_size());
	if (err) {
		printk("Cannot provide input data (err: %d)\n", err);
		printk("Increase CONFIG_EI_WRAPPER_DATA_BUF_SIZE\n");
		return;
	}
	cnt += ei_wrapper_get_window_size();

	err = ei_wrapper_start_prediction(0, 0);
	if (err) {
		printk("Cannot start prediction (err: %d)\n", err);
	} else {
		printk("Prediction started...\n");
                prediction_running = true;
	}

	/* Predictions for additional data are triggered in the result ready
	 * callback. The prediction start can be triggered before the input
	 * data is provided. In that case the prediction is started right
	 * after the prediction window is filled with data.
	 */         

	frame_surplus = (ARRAY_SIZE(mic_buffer) - ei_wrapper_get_window_size())
			/ ei_wrapper_get_frame_size();


	while (cnt < ARRAY_SIZE(mic_buffer)) {
		err = ei_wrapper_add_data(&mic_buffer[cnt],
					  ei_wrapper_get_frame_size());
		if (err) {
			printk("Cannot provide input data (err: %d)\n", err);
			printk("Increase CONFIG_EI_WRAPPER_DATA_BUF_SIZE\n");
			return;
		}
		cnt += ei_wrapper_get_frame_size();

		//k_sleep(K_MSEC(FRAME_ADD_INTERVAL_MS));
	}


#if EI_CLASSIFIER_HAS_ANOMALY == 1
        printk("    anomaly score: ");
        printk(result.anomaly);
        printk("\r\n");
#endif

        //if(ei_user_invoke_stop()) {
        //    printk("Inferencing stopped by user\r\n");
        //    break;
        //}
    }

    ei_microphone_inference_end();
}

void main(void)
{

    ///* Initialize board uart */
    //if(uart_init() != 0){
    //    ei_printf("Init uart on board error occured\r\n");
    //}

    ///** Initialize development board LEDs */
    //if(BOARD_ledInit() != 0){
    //    ei_printf("Init LEDs on board error occured\r\n");
    //}

    ///* Initialize Zephyr flash device */
    //create_flash_device();

    ///* Initialize Edge Impuls sensors and commands */
    //ei_init();

    //while(1){
    //    ei_main();
    //}

	//bool led_is_on = true;
	int ret;

	led0_dev = device_get_binding(LED0_LABEL);
	if (led0_dev == NULL) {
		return;
	}
        
        led3_dev = device_get_binding(LED3_LABEL);
	if (led3_dev == NULL) {
		return;
	}

	ret = gpio_pin_configure(led0_dev, LED0_PIN, GPIO_OUTPUT_ACTIVE | LED0_FLAGS);
	if (ret < 0) {
		return;
	}

        ret = gpio_pin_configure(led3_dev, LED3_PIN, GPIO_OUTPUT_ACTIVE | LED3_FLAGS);
	if (ret < 0) {
		return;
	}

        /* Setup the microphone sensor */
        ei_microphone_init();

	int err = ei_wrapper_init(result_ready_cb);

	if (err) {
		printk("Edge Impulse wrapper failed to initialize (err: %d)\n",
		       err);
		return;
	};

	//if (ARRAY_SIZE(input_data) < ei_wrapper_get_window_size()) {
	//	printk("Not enough input data\n");
	//	return;
	//}

	//if (ARRAY_SIZE(input_data) % ei_wrapper_get_frame_size() != 0) {
	//	printk("Improper number of input samples\n");
	//	return;
	//}

	//size_t cnt = 0;

	/* input_data is defined in input_data.h file. */
	//err = ei_wrapper_add_data(&input_data[cnt],
	//			  ei_wrapper_get_window_size());
	//if (err) {
	//	printk("Cannot provide input data (err: %d)\n", err);
	//	printk("Increase CONFIG_EI_WRAPPER_DATA_BUF_SIZE\n");
	//	return;
	//}
	//cnt += ei_wrapper_get_window_size();

	//err = ei_wrapper_start_prediction(0, 0);
	//if (err) {
	//	printk("Cannot start prediction (err: %d)\n", err);
	//} else {
	//	printk("Prediction started...\n");
	//}

	/* Predictions for additional data are triggered in the result ready
	 * callback. The prediction start can be triggered before the input
	 * data is provided. In that case the prediction is started right
	 * after the prediction window is filled with data.
	 */
	//frame_surplus = (ARRAY_SIZE(input_data) - ei_wrapper_get_window_size())
	//		/ ei_wrapper_get_frame_size();

	//while (cnt < ARRAY_SIZE(input_data)) {
	//	err = ei_wrapper_add_data(&input_data[cnt],
	//				  ei_wrapper_get_frame_size());
	//	if (err) {
	//		printk("Cannot provide input data (err: %d)\n", err);
	//		printk("Increase CONFIG_EI_WRAPPER_DATA_BUF_SIZE\n");
	//		return;
	//	}
	//	cnt += ei_wrapper_get_frame_size();

	//	k_sleep(K_MSEC(FRAME_ADD_INTERVAL_MS));
	//}

        gpio_pin_set(led0_dev, LED0_PIN, 0);
        gpio_pin_set(led3_dev, LED3_PIN, 0);
	while (1) {
                run_nn();

		//gpio_pin_set(led0_dev, LED0_PIN, (int)led_is_on);
		//gpio_pin_set(led3_dev, LED3_PIN, (int)!led_is_on);
		//led_is_on = !led_is_on;
		//k_msleep(SLEEP_TIME_MS);
                k_yield();
	}
}
```

## src/main.cpp
```c
#include <zephyr.h>
//#include "ei_run_classifier.h"
#include "numpy.hpp"

#include <sys/printk.h>
#include "ei_device_nordic_nrf52.h"
#include "ei_zephyr_flash_commands.h"
#include "ei_main.h"
#include <device.h>
#include <devicetree.h>
#include <drivers/gpio.h>

/* The devicetree node identifier for the "led0" alias. */
#define LED0_NODE DT_ALIAS(led0)
#define LED3_NODE DT_ALIAS(led3)

#if DT_NODE_HAS_STATUS(LED0_NODE, okay)
#define LED0_LABEL	DT_GPIO_LABEL(LED0_NODE, gpios)
#define LED0_PIN	DT_GPIO_PIN(LED0_NODE, gpios)
#define LED0_FLAGS	DT_GPIO_FLAGS(LED0_NODE, gpios)
#else
/* A build error here means your board isn't set up to blink an LED. */
#error "Unsupported board: led0 devicetree alias is not defined"
#define LED0_LABEL	""
#define LED0_PIN	0
#define LED0_FLAGS	0
#endif

#if DT_NODE_HAS_STATUS(LED3_NODE, okay)
#define LED3_LABEL	DT_GPIO_LABEL(LED3_NODE, gpios)
#define LED3_PIN	DT_GPIO_PIN(LED3_NODE, gpios)
#define LED3_FLAGS	DT_GPIO_FLAGS(LED3_NODE, gpios)
#else
/* A build error here means your board isn't set up to blink an LED. */
#error "Unsupported board: led3 devicetree alias is not defined"
#define LED3_LABEL	""
#define LED3_PIN	0
#define LED3_FLAGS	0
#endif


const struct device *led0_dev;
const struct device *led3_dev;


int main(void)
{
    int ret;

    led0_dev = device_get_binding(LED0_LABEL);
    if (led0_dev == NULL) {
            return -1;
    }

    led3_dev = device_get_binding(LED3_LABEL);
    if (led3_dev == NULL) {
            return -1;
    }

    ret = gpio_pin_configure(led0_dev, LED0_PIN, GPIO_OUTPUT_ACTIVE | LED0_FLAGS);
    if (ret < 0) {
            return ret;
    }

    ret = gpio_pin_configure(led3_dev, LED3_PIN, GPIO_OUTPUT_ACTIVE | LED3_FLAGS);
    if (ret < 0) {
            return ret;
    }

        
    //gpio_pin_set(led0_dev, LED0_PIN, 1);
    //gpio_pin_set(led3_dev, LED3_PIN, 1);

    /* This is needed so that output of printf 
       is output immediately without buffering 
    */
    setvbuf(stdout, NULL, _IONBF, 0);

    /* Initialize board uart */
    if(uart_init() != 0){
        ei_printf("Init uart on board error occured\r\n");
    }

    /** Initialize development board LEDs */
    if(BOARD_ledInit() != 0){
        ei_printf("Init LEDs on board error occured\r\n");
    }

    /* Initialize Zephyr flash device */
    create_flash_device();

    /* Initialize Edge Impuls sensors and commands */
    ei_init();

    while(1){
        ei_main();
    }
}
```

## src/ei_microphone.cpp
```c
/* Edge Impulse ingestion SDK
 * Copyright (c) 2021 EdgeImpulse Inc.
 *
 * Permission is hereby granted, free of charge, to any person obtaining a copy
 * of this software and associated documentation files (the "Software"), to deal
 * in the Software without restriction, including without limitation the rights
 * to use, copy, modify, merge, publish, distribute, sublicense, and/or sell
 * copies of the Software, and to permit persons to whom the Software is
 * furnished to do so, subject to the following conditions:
 *
 * The above copyright notice and this permission notice shall be included in
 * all copies or substantial portions of the Software.
 *
 * THE SOFTWARE IS PROVIDED "AS IS", WITHOUT WARRANTY OF ANY KIND, EXPRESS OR
 * IMPLIED, INCLUDING BUT NOT LIMITED TO THE WARRANTIES OF MERCHANTABILITY,
 * FITNESS FOR A PARTICULAR PURPOSE AND NONINFRINGEMENT. IN NO EVENT SHALL THE
 * AUTHORS OR COPYRIGHT HOLDERS BE LIABLE FOR ANY CLAIM, DAMAGES OR OTHER
 * LIABILITY, WHETHER IN AN ACTION OF CONTRACT, TORT OR OTHERWISE, ARISING FROM,
 * OUT OF OR IN CONNECTION WITH THE SOFTWARE OR THE USE OR OTHER DEALINGS IN THE
 * SOFTWARE.
 */

/* Include ----------------------------------------------------------------- */
#include "ei_microphone.h"
//#include "ei_device_nordic_nrf52.h"
//#include "ei_classifier_porting.h"

//#include "ei_config_types.h"
//#include "sensor_aq_mbedtls_hs256.h"
//#include "sensor_aq_none.h"

#include <zephyr.h>
#include <nrfx_pdm.h>
#include <string.h>

/* Read nordic id from the registers */
#if ((CONFIG_SOC_NRF52840 == 1) || \
       (CONFIG_SOC_NRF52840_QIAA == 1))
#define PDM_CLK_PIN                         36// 32+4 = p1.04
#define PDM_DIN_PIN                         37// 32+5 = p1.05
#elif ((CONFIG_SOC_NRF5340_CPUAPP == 1) || \
       (CONFIG_SOC_NRF5340_CPUAPP_QKAA == 1))
#define PDM_CLK_PIN                         37// 32+5 = p1.05
#define PDM_DIN_PIN                         38// 32+6 = p1.06
#else 
#error "Unsupported build target was chosen!"
#endif

/* Audio sampling config */
#define AUDIO_SAMPLING_FREQUENCY            16000
#define AUDIO_SAMPLES_PER_MS                (AUDIO_SAMPLING_FREQUENCY / 1000)
#define AUDIO_DSP_SAMPLE_LENGTH_MS          16
#define AUDIO_DSP_SAMPLE_RESOLUTION         (sizeof(short))
#define AUDIO_DSP_SAMPLE_BUFFER_SIZE        (AUDIO_SAMPLES_PER_MS * AUDIO_DSP_SAMPLE_LENGTH_MS * AUDIO_DSP_SAMPLE_RESOLUTION) //4096

/* Buffers for receiving PDM mic data */
static int16_t pdm_buffer_temp[2][AUDIO_DSP_SAMPLE_BUFFER_SIZE] = {0};
int16_t *current_buff;
volatile bool write_data = false;
bool microphone_started = false;

/** Status and control struct for inferencing struct */
typedef struct {
    int16_t *buffers[2];
    uint8_t buf_select;
    uint8_t buf_ready;
    uint32_t buf_count;
    uint32_t n_samples;
} inference_t;

//extern ei_config_t *ei_config_get_config();

///* Dummy functions for sensor_aq_ctx type */
//static size_t ei_write(const void*, size_t size, size_t count, EI_SENSOR_AQ_STREAM*)
//{
//    return count;
//}

//static int ei_seek(EI_SENSOR_AQ_STREAM*, long int offset, int origin)
//{
//    return 0;
//}

/* Private variables ------------------------------------------------------- */
static bool record_ready = false;

static volatile inference_t inference;

//static unsigned char ei_mic_ctx_buffer[1024];
//static sensor_aq_signing_ctx_t ei_mic_signing_ctx;
//static sensor_aq_mbedtls_hs256_ctx_t ei_mic_hs_ctx;
//static sensor_aq_ctx ei_mic_ctx = {
//    { ei_mic_ctx_buffer, 1024 },
//    &ei_mic_signing_ctx,
//    &ei_write,
//    &ei_seek,
//    NULL,
//};

/* Private functions ------------------------------------------------------- */

/**
 * @brief      Inference audio callback, store samples in ram buffer
 *             Signal when buffer is full, and swap buffers
 * @param      buffer   Pointer to source buffer
 * @param[in]  n_bytes  Number of bytes to write
 */
static void audio_buffer_inference_callback(void *buffer, uint32_t n_bytes)
{
    int16_t *samples = (int16_t *)buffer;

    for(uint32_t i = 0; i < (n_bytes >> 1); i++) {
        inference.buffers[inference.buf_select][inference.buf_count++] = samples[i];

        if(inference.buf_count >= inference.n_samples) {
            inference.buf_select ^= 1;
            inference.buf_count = 0;
            inference.buf_ready = 1;
        }
    }
}

/**
 * @brief      PDM receive data handler
 * @param[in]  p_evt  pdm event structure
 */
static void pdm_data_handler(nrfx_pdm_evt_t const * p_evt)
{
    nrfx_err_t err = NRFX_SUCCESS;
    static uint8_t buf_toggle = 0;

    if(p_evt->error != 0){
        printk("PDM handler error ocured\n");
        printk("pdm_data_handler error: %d, %d  \n", p_evt->error, p_evt->buffer_requested);
        return;
    }
    if(true == p_evt->buffer_requested){
        buf_toggle ^= 1;
        err = nrfx_pdm_buffer_set(pdm_buffer_temp[buf_toggle], AUDIO_DSP_SAMPLE_BUFFER_SIZE);
        if(err != NRFX_SUCCESS){
            printk("PDM buffer init error: %d\n", err);
        }
    }
    if(p_evt->buffer_released != NULL){
            write_data = true;
            current_buff = pdm_buffer_temp[buf_toggle];
    }
}

/**
 * @brief      Capture 2 channel pdm data every 100 ms.
 *             Waits for new data to be ready.
 *             Creates a 1 channel pdm array and calls callback function
 * @param[in]  callback  Callback needs to handle the audio samples
 */
static void get_dsp_data(void (*callback)(void *buffer, uint32_t n_bytes))
{
    //TODO: check the number of bytes
    //printk("1 write_data:%d", write_data);
    if(write_data ==true){
            //printk("Calling inference callback");
            callback((void *)current_buff, sizeof(pdm_buffer_temp)/2);
        write_data = false;
    }
    //printk("2 write_data:%d \r\n", write_data);
}

/* Public functions -------------------------------------------------------- */

/**
 * @brief      Set the PDM mic to +34dB
 */
void ei_microphone_init(void)
{
    nrfx_err_t err;

    /* PDM driver configuration */
    nrfx_pdm_config_t config_pdm = NRFX_PDM_DEFAULT_CONFIG(PDM_CLK_PIN, PDM_DIN_PIN);
    config_pdm.clock_freq = NRF_PDM_FREQ_1280K;
    config_pdm.ratio = NRF_PDM_RATIO_80X;
    config_pdm.edge = NRF_PDM_EDGE_LEFTRISING;
    config_pdm.gain_l = NRF_PDM_GAIN_MAXIMUM;
    config_pdm.gain_r = NRF_PDM_GAIN_MAXIMUM;

    /* PDM interrupt configuration necessary for Zephyr */
#if ((CONFIG_SOC_NRF52840 == 1) || \
       (CONFIG_SOC_NRF52840_QIAA == 1))
    IRQ_DIRECT_CONNECT(PDM_IRQn, 6, nrfx_pdm_irq_handler, 0);
#elif ((CONFIG_SOC_NRF5340_CPUAPP == 1) || \
       (CONFIG_SOC_NRF5340_CPUAPP_QKAA == 1))
    IRQ_DIRECT_CONNECT(PDM0_IRQn, 6, nrfx_pdm_irq_handler, 0);
#else 
#error "Unsupported build target was chosen!"
#endif

    err = nrfx_pdm_init(&config_pdm, pdm_data_handler);
    if(err != NRFX_SUCCESS){
        printk("PDM init error: %d\n", err);
    }
    else{
        printk("PDM init OK\n");
    }
}

bool ei_microphone_inference_start(uint32_t n_samples)
{
    nrfx_err_t err;

    inference.buffers[0] = (int16_t *)malloc(n_samples * sizeof(int16_t));

    if(inference.buffers[0] == NULL) {
        return false;
    }

    inference.buffers[1] = (int16_t *)malloc(n_samples * sizeof(int16_t));

    if(inference.buffers[1] == NULL) {
        free(inference.buffers[0]);
        return false;
    }

    inference.buf_select = 0;
    inference.buf_count  = 0;
    inference.n_samples  = n_samples;
    inference.buf_ready  = 0;

    err = nrfx_pdm_start();
    if(err != NRFX_SUCCESS){
        return false;
    }

    microphone_started = true;

    return true;
}

bool ei_microphone_inference_record(void)
{
    while (inference.buf_ready == 0) {
        get_dsp_data(&audio_buffer_inference_callback);
    };
 
    inference.buf_ready = 0;

    return true;
}

/**
 * @brief      Reset buffer counters for non-continuous inferecing
 */
void ei_microphone_inference_reset_buffers(void)
{
    inference.buf_ready = 0;
    inference.buf_count = 0;
}

/**
 * Get raw audio signal data
 */
int ei_microphone_audio_signal_get_data(size_t offset, size_t length, float *out_ptr)
{
    size_t i;

    for(i = 0; i < length; i++) {
        *(out_ptr + i) = (float)inference.buffers[inference.buf_select ^ 1][offset + i]
        / ((float)(1 << 15));
    }

    return 0;
}

bool ei_microphone_inference_end(void)
{
    uint32_t nrfx_err;
    record_ready = false;

    nrfx_err = nrfx_pdm_stop();
    if(nrfx_err != NRFX_SUCCESS)
    {
        printk("PDM Could not stop PDM sampling, error = %d", nrfx_err);
    }
    else
    {
        microphone_started = false;
    }

    free(inference.buffers[0]);
    free(inference.buffers[1]);
    return true;
}

bool ei_microphone_inference_started(void)
{
    return microphone_started;
}
```
